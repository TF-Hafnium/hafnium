/*
 * Copyright 2023 The Hafnium Authors.
 *
 * Use of this source code is governed by a BSD-style
 * license that can be found in the LICENSE file or at
 * https://opensource.org/licenses/BSD-3-Clause.
 */

/dts-v1/;

/ {
	compatible = "arm,ffa-manifest-1.1";
	debug_name = "partition-manifest";

	/* Properties */
	ffa-version = <0x00010002>; /* 31:16 - Major, 15:0 - Minor */
	execution-ctx-count = <1>;
	exception-level = <6>; /* EL0 */
	execution-state = <0>; /* AARCH64 */
	load-address = <0x90000000>;
	entrypoint-offset = <0x0>;
	xlat-granule = <0>; /* 4KiB */

	services {
		compatible = "arm,ffa-manifest-services";

		service0 {
			uuid = "5d45882e-0000-f637-0000-a7200e8669dc";
			messaging-method = <0x7>; /* Direct and indirect requests. */
		};

		service1 {
			uuid = "6e56993f-0000-0748-0000-b8310f977aed";
			messaging-method = <0x7>; /* Direct and indirect requests. */
		};
	};
};
