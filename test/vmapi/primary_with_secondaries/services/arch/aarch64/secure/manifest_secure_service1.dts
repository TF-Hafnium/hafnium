/*
 * Copyright 2022 The Hafnium Authors.
 *
 * Use of this source code is governed by a BSD-style
 * license that can be found in the LICENSE file or at
 * https://opensource.org/licenses/BSD-3-Clause.
 */

/ {
	hypervisor {
		compatible = "hafnium,hafnium";
		vm1 {
			is_ffa_partition;
			load_address = <0x6480000>;
			debug_name = "Secure Service1";
			vcpu_count = <8>;
			mem_size = <0x100000>;
			smc_whitelist=<0x82000100>;
		};
	};
};
