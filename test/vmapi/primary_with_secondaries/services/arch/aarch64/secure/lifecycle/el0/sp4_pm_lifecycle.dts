/*
 * Copyright 2025 The Hafnium Authors.
 *
 * Use of this source code is governed by a BSD-style
 * license that can be found in the LICENSE file or at
 * https://opensource.org/licenses/BSD-3-Clause.
 */

/dts-v1/;

/ {
	compatible = "arm,ffa-manifest-1.1";
	debug_name = "Service4 Lifecycle SP EL0";

	/* Properties */
	ffa-version = <0x00010002>; /* 31:16 - Major, 15:0 - Minor */
	execution-ctx-count = <1>;
	exception-level = <1>; /* S-EL0 */
	execution-state = <0>; /* AARCH64 */
	load-address = <0x6180000>;
	entrypoint-offset = <0x2000>;
	xlat-granule = <0>; /* 4KiB */
	boot-order = <4>;
	notification-support; /* Receipt of notifications. */
	gp-register-num = <0>;
	abort-action = <2>; /* Restart */
	lifecycle-support;

	services {
		compatible = "arm,ffa-manifest-services";

		service0 {
			uuid = "d6d78930-6cb2-6103-da31-1d35fc03fced";
			messaging-method = <0x7>; /* Supports direct and indirect requests. */
		};
	};

	/* Boot Info */
	boot-info {
		compatible = "arm,ffa-manifest-boot-info";
		ffa_manifest;
	};
};
