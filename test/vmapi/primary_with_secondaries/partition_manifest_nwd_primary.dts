/*
 * Copyright 2022 The Hafnium Authors.
 *
 * Use of this source code is governed by a BSD-style
 * license that can be found in the LICENSE file or at
 * https://opensource.org/licenses/BSD-3-Clause.
 */

/dts-v1/;

/ {
	compatible = "arm,ffa-manifest-1.1";
	debug_name = "partition-manifest";

	/* Properties */
	ffa-version = <0x00010002>; /* 31:16 - Major, 15:0 - Minor */
	execution-ctx-count = <8>;
	exception-level = <0>; /* EL1 */
	execution-state = <0>; /* AARCH64 */
	load-address = <0x90000000>;
	entrypoint-offset = <0x2000>;
	xlat-granule = <0>; /* 4KiB */
	notification-support; /* Receipt of notifications. */

	services {
		compatible = "arm,ffa-manifest-services";

		service0 {
			uuid = "bdfaab86-0000-e9ee-0000-409ade614c01";
			messaging-method = <0x607>; /* Supports direct and indirect requests. */
		};
	};
};
