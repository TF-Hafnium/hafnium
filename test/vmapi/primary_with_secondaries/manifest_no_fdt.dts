/*
 * Copyright 2020 The Hafnium Authors.
 *
 * Use of this source code is governed by a BSD-style
 * license that can be found in the LICENSE file or at
 * https://opensource.org/licenses/BSD-3-Clause.
 */

/dts-v1/;

/ {
	hypervisor {
		compatible = "hafnium,hafnium";
		vm1 {
			debug_name = "primary_with_secondaries_no_fdt";
			kernel_filename = "primary_with_secondaries_no_fdt";
		};

		vm2 {
			debug_name = "secondary_vm_no_fdt";
			vcpu_count = <1>;
			mem_size = <0x100000>;
			kernel_filename = "secondary_vm_no_fdt";
		};
	};
};
