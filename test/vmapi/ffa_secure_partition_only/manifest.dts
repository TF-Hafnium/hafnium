/*
 * Copyright 2020 The Hafnium Authors.
 *
 * Use of this source code is governed by a BSD-style
 * license that can be found in the LICENSE file or at
 * https://opensource.org/licenses/BSD-3-Clause.
 */

/ {
	hypervisor {
		compatible = "hafnium,hafnium";
		vm1 {
			is_ffa_partition;
			load_address = <0x6280000>;
			debug_name = "ffa_secure_partition";
			vcpu_count = <8>;
			mem_size = <1048576>;
			/* Required by arch.smccc_forward test: */
			smc_whitelist = <0x82000010>;
		};
	};
};
