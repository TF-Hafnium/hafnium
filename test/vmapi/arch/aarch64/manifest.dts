/*
 * Copyright 2020 The Hafnium Authors.
 *
 * Use of this source code is governed by a BSD-style
 * license that can be found in the LICENSE file or at
 * https://opensource.org/licenses/BSD-3-Clause.
 */

/dts-v1/;

/ {
	hypervisor {
		compatible = "hafnium,hafnium";
		vm1 {
			debug_name = "aarch64_test";
			kernel_filename = "aarch64_test";
			uuid = <0x0 0x0 0x0 0x1>;
			messaging_method = <0x2>;

			smc_whitelist = <
				0x30000001
				0x30000002
				0x30000003
				0x30000004
				>;
		};
	};
};
