/*
 * Copyright 2020 The Hafnium Authors.
 *
 * Use of this source code is governed by a BSD-style
 * license that can be found in the LICENSE file or at
 * https://opensource.org/licenses/BSD-3-Clause.
 */

/dts-v1/;

/ {
	hypervisor {
		compatible = "hafnium,hafnium";
		ffa_tee_enabled;
		vm1 {
			debug_name = "trusty_test";
			kernel_filename = "trusty_test";
		};
	};
};
