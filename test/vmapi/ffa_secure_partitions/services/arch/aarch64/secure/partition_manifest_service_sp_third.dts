/*
 * Copyright 2023 The Hafnium Authors.
 *
 * Use of this source code is governed by a BSD-style
 * license that can be found in the LICENSE file or at
 * https://opensource.org/licenses/BSD-3-Clause.
 */

/dts-v1/;

/ {
	compatible = "arm,ffa-manifest-1.1";
	debug_name = "SP Service Third";

	/* Properties */
	ffa-version = <0x00010002>; /* 31:16 - Major, 15:0 - Minor */
	execution-ctx-count = <8>;
	exception-level = <2>; /* S-EL1 */
	execution-state = <0>; /* AARCH64 */
	load-address = <0x6280000>;
	entrypoint-offset = <0x2000>;
	xlat-granule = <0>; /* 4KiB */
	boot-order = <3>;
	notification-support; /* Receipt of notifications. */
	ns-interrupts-action = <0>; /* Non secure interrupts are queued. */
	other-s-interrupts-action = <0>; /* Other S-Interrupts are queued. */
	gp-register-num = <0>;
	power-management-messages = <1>; /* Support CPU_OFF power management message. */

	services {
		compatible = "arm,ffa-manifest-services";

		service0 {
			uuid = "1df938ef-e8b9-4490-8496-7204ab77f4a5";
			messaging-method = <0x7>; /* Supports direct and indirect requests. */
		};
	};

	/* Boot Info */
	boot-info {
		compatible = "arm,ffa-manifest-boot-info";
		ffa_manifest;
	};
};
