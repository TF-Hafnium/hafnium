/*
 * Copyright 2023 The Hafnium Authors.
 *
 * Use of this source code is governed by a BSD-style
 * license that can be found in the LICENSE file or at
 * https://opensource.org/licenses/BSD-3-Clause.
 */

/ {
	hypervisor {
		compatible = "hafnium,hafnium";
		vm1 {
			is_ffa_partition;
			/*
			 * `mem_size` bumped from 0x100000 to 0x200000:
			 * `sp_ffa_mem_lend_cmd()` (partition_services.c)
			 * needs ~264 one-page constituents this SP genuinely
			 * owns (beyond its own `image_end`) to LEND a single
			 * fragment bigger than one FF-A page to another SP;
			 * that headroom is only mapped and owned if `mem_size`
			 * actually covers it. Only this manifest changes: the
			 * secure_partitions_services binary itself is
			 * unaffected (no dedicated static array), so SP2
			 * sharing that same binary via a different manifest
			 * keeps its original 0x100000 budget. (SP First's own
			 * manifest was separately bumped the same way for its
			 * own v1.0 LEND test.)
			 */
			load_address = <0x6180000>;
			debug_name = "SP Service Third";
			vcpu_count = <8>;
			mem_size = <0x200000>;
		};
	};
};
