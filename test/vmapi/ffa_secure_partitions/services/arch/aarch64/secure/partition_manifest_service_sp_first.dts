/*
 * Copyright 2021 The Hafnium Authors.
 *
 * Use of this source code is governed by a BSD-style
 * license that can be found in the LICENSE file or at
 * https://opensource.org/licenses/BSD-3-Clause.
 */

/dts-v1/;

/ {
	compatible = "arm,ffa-manifest-1.1";
	debug_name = "SP Service First";

	/* Properties */

	/*
	 * Use FF-A version 1.0 because it is required by the tests in
	 * `ffa_secure_partitions/memory_sharing.c`. Ideally we would set the
	 * version at runtime, but that is not allowed after subsequent FF-A ABI
	 * calls anymore.
	 */
	ffa-version = <0x00010000>; /* 31:16 - Major, 15:0 - Minor */
	execution-ctx-count = <8>;
	exception-level = <2>; /* S-EL1 */
	execution-state = <0>; /* AARCH64 */
	load-address = <0x6480000>;
	entrypoint-offset = <0x2000>;
	xlat-granule = <0>; /* 4KiB */
	vm-availability-messages = <0x03>; /* Supports VM created and VM destroyed messages. */
	ns-interrupts-action = <1>; /* Managed exit is supported. */
	managed-exit-virq;
	boot-order = <1>;
	notification-support; /* Receipt of notifications. */
	gp-register-num = <0>;
	power-management-messages = <1>; /* Support CPU_OFF power management message. */

	services {
		compatible = "arm,ffa-manifest-services";

		service0 {
			uuid = "9458bb2d-353b-4ee2-aa25-710c99b73ddc";
			messaging-method = <0x7>; /* Supports direct and indirect requests. */
		};
	};

	/* Boot Info */
	boot-info {
		compatible = "arm,ffa-manifest-boot-info";
		ffa_manifest;
	};
};
