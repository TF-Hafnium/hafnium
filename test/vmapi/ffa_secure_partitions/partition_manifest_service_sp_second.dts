/*
 * Copyright 2021 The Hafnium Authors.
 *
 * Use of this source code is governed by a BSD-style
 * license that can be found in the LICENSE file or at
 * https://opensource.org/licenses/BSD-3-Clause.
 */

/dts-v1/;

/ {
	compatible = "arm,ffa-manifest-1.0";
	debug_name = "SP Service Second EL1";

	/* Properties */
	ffa-version = <0x00010001>; /* 31:16 - Major, 15:0 - Minor */
	uuid = <0xa609f132 0x6b4f 0x4c14 0x9489>;
	execution-ctx-count = <8>;
	exception-level = <2>; /* S-EL1 */
	execution-state = <0>; /* AARCH64 */
	load-address = <0x6380000>;
	entrypoint-offset = <0x2000>;
	xlat-granule = <0>; /* 4KiB */
	messaging-method = <0x3>; /* Supports sending/receiving direct requests. */
	boot-order = <4>;
	notification-support; /* Receipt of notifications. */
};
