/*
 * Copyright 2020 The Hafnium Authors.
 *
 * Use of this source code is governed by a BSD-style
 * license that can be found in the LICENSE file or at
 * https://opensource.org/licenses/BSD-3-Clause.
 */

/dts-v1/;
/plugin/;

&{/} {

	/* We want to always run the same test secure_bare_metal, first */
	chosen {
		bootargs = "run secure_bare_metal first";
		stdout-path = "serial0:115200n8";
		linux,initrd-start = <0x6280000>;
		linux,initrd-end = <0x6380000>;
	};

	hypervisor {
		compatible = "hafnium,hafnium";
		vm1 {
			debug_name = "linux_test";
			kernel_filename = "vmlinuz";
			ramdisk_filename = "initrd.img";
			uuid = <0x1 0x1 0x1 0x1>;
			messaging_method = <0x2>;
		};
	};
};
