/*
 * Copyright 2020 The Hafnium Authors.
 *
 * Use of this source code is governed by a BSD-style
 * license that can be found in the LICENSE file or at
 * https://opensource.org/licenses/BSD-3-Clause.
 */

/dts-v1/;

/ {
	hypervisor {
		compatible = "hafnium,hafnium";
		vm1 {
			debug_name = "linux_test";
			kernel_filename = "vmlinuz";
			ramdisk_filename = "initrd.img";
			uuid = <0x0 0x0 0x0 0x1>;
			messaging_method = <0x2>;
		};

		vm2 {
			debug_name = "socket0";
			vcpu_count = <1>;
			mem_size = <0x100000>;
			kernel_filename = "socket0";
			uuid = <0x0 0x0 0x0 0x2>;
			messaging_method = <0x2>;
		};
	};
};
